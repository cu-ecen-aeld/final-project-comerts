## meta-log-proxy/conf/layer.conf
```bitbake
# We have a conf and classes directory, add to BBPATH
BBPATH .= ":${LAYERDIR}"

# We have recipes-* directories, add to BBFILES
BBFILES += "${LAYERDIR}/recipes-*/*/*.bb \
            ${LAYERDIR}/recipes-*/*/*.bbappend"

BBFILE_COLLECTIONS += "meta-log-proxy"
BBFILE_PATTERN_meta-log-proxy = "^${LAYERDIR}/"
BBFILE_PRIORITY_meta-log-proxy = "6"

LAYERDEPENDS_meta-log-proxy = "core"
LAYERSERIES_COMPAT_meta-log-proxy = "hardknott kirkstone"
```
